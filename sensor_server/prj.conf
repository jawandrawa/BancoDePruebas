## prj.conf
```kconfig
#
# Copyright (c) 2020 Nordic Semiconductor ASA
#
# SPDX-License-Identifier: LicenseRef-Nordic-5-Clause
#
CONFIG_NCS_SAMPLES_DEFAULTS=y

# Deffered logging helps improve LPN power consumption
# when friendship is established.
CONFIG_LOG_MODE_DEFERRED=y

# General configuration
CONFIG_SYSTEM_WORKQUEUE_STACK_SIZE=2048
CONFIG_FLASH=y
CONFIG_FLASH_MAP=y
CONFIG_NVS=y
CONFIG_NVS_LOOKUP_CACHE=y
CONFIG_SETTINGS=y
CONFIG_SETTINGS_NVS_NAME_CACHE=y
CONFIG_HWINFO=y
CONFIG_DK_LIBRARY=y
CONFIG_PM_SINGLE_IMAGE=y
CONFIG_PM_PARTITION_SIZE_SETTINGS_STORAGE=0x8000
CONFIG_SOC_FLASH_NRF_PARTIAL_ERASE=y

# Temperature sensor
CONFIG_SENSOR=y
CONFIG_TEMP_NRF5=y

# Bluetooth configuration
CONFIG_BT=y
CONFIG_BT_COMPANY_ID=0x0059
#TODO: poner el id del sensor
CONFIG_BT_DEVICE_NAME="Sensor Server 32" #1....n
CONFIG_BT_L2CAP_TX_BUF_COUNT=8
CONFIG_BT_OBSERVER=y
CONFIG_BT_PERIPHERAL=y
CONFIG_BT_SETTINGS=y

# Disable unused Bluetooth features
CONFIG_BT_CTLR_DUP_FILTER_LEN=0
CONFIG_BT_CTLR_LE_ENC=n
CONFIG_BT_PHY_UPDATE=n
CONFIG_BT_CTLR_CHAN_SEL_2=n
CONFIG_BT_CTLR_MIN_USED_CHAN=n
CONFIG_BT_CTLR_PRIVACY=n

# Bluetooth mesh configuration
CONFIG_BT_MESH=y
CONFIG_BT_MESH_RELAY=y
CONFIG_BT_MESH_FRIEND=y
CONFIG_BT_MESH_TX_SEG_MAX=10
CONFIG_BT_MESH_PB_GATT=y
CONFIG_BT_MESH_GATT_PROXY=y
CONFIG_BT_MESH_PROXY_USE_DEVICE_NAME=y
CONFIG_BT_MESH_DK_PROV=y
CONFIG_BT_MESH_NLC_PERF_CONF=y

# Bluetooth mesh models
CONFIG_BT_MESH_SENSOR_SRV=y
CONFIG_BT_MESH_SENSOR_SRV_SENSORS_MAX=100
```

## src/main.c
```c
/*
 * Copyright (c) 2020 Nordic Semiconductor ASA
 *
 * SPDX-License-Identifier: LicenseRef-Nordic-5-Clause
 */

/** @file
 *  @brief Nordic mesh sensor sample
 */
#include <zephyr/bluetooth/bluetooth.h>
#include <bluetooth/mesh/models.h>
#include <bluetooth/mesh/dk_prov.h>,
#include <dk_buttons_and_leds.h>
#include "model_handler.h"
#define PERIOD_SEND_MS 5000 //TODO: periodo del envio de datos

//-----para latencia------
#include <zephyr/drivers/gpio.h>
#define LED0_NODE DT_ALIAS(led0)
static const struct gpio_dt_spec gpio0_3 = GPIO_DT_SPEC_GET(LED0_NODE, gpios);
//-------------------

static void bt_ready(int err)
{
	if (err) {
		printk("Bluetooth init failed (err %d)\n", err);
		return;
	}

	printk("Bluetooth initialized\n");


	err = bt_mesh_init(bt_mesh_dk_prov_init(), model_handler_init());
	if (err) {
		printk("Initializing mesh failed (err %d)\n", err);
		return;
	}

	if (IS_ENABLED(CONFIG_SETTINGS)) {
		settings_load();
	}

	bt_mesh_prov_enable(BT_MESH_PROV_ADV | BT_MESH_PROV_GATT);

	printk("Mesh initialized\n");
}

int main(void)
{
	int err;

	printk("Initializing...\n");

	err = bt_enable(bt_ready);
	if (err) {
		printk("Bluetooth init failed (err %d)\n", err);
	}
	//-----para latencia-------
	gpio_pin_configure_dt(&gpio0_3,GPIO_OUTPUT_ACTIVE);
	gpio_pin_set(gpio0_3.port,gpio0_3.pin,0);
	//--------------------------			
	/**
	 * Comentar el while si se quiere que el nodo solo retransmita, 
	 * para el salto de HOPS
	 */
	while(1){

		if(bt_mesh_is_provisioned()){
			//-----para latencia-------
			gpio_pin_set(gpio0_3.port,gpio0_3.pin,1);
			//--------------------------			

			send_data();

			//-----para latencia-------
			gpio_pin_set(gpio0_3.port,gpio0_3.pin,0);
			//--------------------------
		}

		k_sleep(K_MSEC(PERIOD_SEND_MS));

	}
	return 0;
}
```

## include/model_handler.h
```c
/*
 * Copyright (c) 2020 Nordic Semiconductor ASA
 *
 * SPDX-License-Identifier: LicenseRef-Nordic-5-Clause
 */

/**
 * @file
 * @brief Model handler
 */

#ifndef MODEL_HANDLER_H__
#define MODEL_HANDLER_H__

#include <zephyr/bluetooth/mesh.h>

#ifdef __cplusplus
extern "C" {
#endif

const struct bt_mesh_comp *model_handler_init(void);
int send_data(void);
#ifdef __cplusplus
}
#endif

#endif /* MODEL_HANDLER_H__ */
```

## src/model_handler.c
```c
/*
 * Copyright (c) 2020 Nordic Semiconductor ASA
 *
 * SPDX-License-Identifier: LicenseRef-Nordic-5-Clause
 */

#include <zephyr/device.h>
#include <zephyr/devicetree.h>
#include <zephyr/bluetooth/bluetooth.h>
#include <zephyr/drivers/sensor.h>
#include <bluetooth/mesh/models.h>
#include <bluetooth/mesh/sensor_types.h>
#include <dk_buttons_and_leds.h>
#include <float.h>
#include "model_handler.h"



static struct bt_mesh_sensor temperature_indoor_sensor = {
	.type = &bt_mesh_sensor_present_indoor_amb_temp,
};
static struct bt_mesh_sensor *const temperature_sensor[] = {
	&temperature_indoor_sensor,
};
static struct bt_mesh_sensor_srv temperaturita_sensor_srv =
	BT_MESH_SENSOR_SRV_INIT(temperature_sensor, ARRAY_SIZE(temperature_sensor));



static struct bt_mesh_sensor humidity_indoor_sensor_level = {
	.type = &bt_mesh_sensor_present_indoor_relative_humidity,
};
static struct bt_mesh_sensor *const humidity_sensor[] = {
	&humidity_indoor_sensor_level,
};
static struct bt_mesh_sensor_srv humidity_sensor_srv =
	BT_MESH_SENSOR_SRV_INIT(humidity_sensor, ARRAY_SIZE(humidity_sensor));


static struct bt_mesh_elem elements[] = {
	//humity
	BT_MESH_ELEM(1,
		     BT_MESH_MODEL_LIST(BT_MESH_MODEL_CFG_SRV,
								BT_MESH_MODEL_SENSOR_SRV(&humidity_sensor_srv)),
		     					BT_MESH_MODEL_NONE),
	//temperature
	BT_MESH_ELEM(2,
		     BT_MESH_MODEL_LIST(BT_MESH_MODEL_SENSOR_SRV(&temperaturita_sensor_srv)),
		     BT_MESH_MODEL_NONE),
};

static const struct bt_mesh_comp comp = {
	.cid = CONFIG_BT_COMPANY_ID,
	.elem = elements,
	.elem_count = ARRAY_SIZE(elements),
};

const struct bt_mesh_comp *model_handler_init(void)
{
	return &comp;
}

struct sensor_value get_temperature(void){
	struct sensor_value temp;
	double rand_temp[5] = {27.5, 27.6, 27.7, 27.8, 27.9};
	int i = rand() % 5;
	sensor_value_from_double(&temp, rand_temp[i]);
	return temp;
}

struct sensor_value get_humidity(void){
	struct sensor_value hum;
	double rand_hum[5] = {0.5, 0.51, 0.52, 0.53, 0.54};
	int i = rand() % 5;
	sensor_value_from_double(&hum, rand_hum[i]);
	return hum;
}

int send_data(void){
	int err;
	struct sensor_value temp;
	struct sensor_value hum;
	//---para sensor a estudiar---
	/*
	sensor_value_from_double(&temp, 1.0);
	sensor_value_from_double(&hum, 1.0);
	*/
	//----------------------------
	temp = get_temperature();
	hum = get_humidity();
	//humidity
	err = bt_mesh_sensor_srv_pub(&humidity_sensor_srv, NULL,&humidity_indoor_sensor_level, &hum);
	if (err) {
		printk("Error publishing humidity(%d)\n", err);
	}
	
	//temperature
	err = bt_mesh_sensor_srv_pub(&temperaturita_sensor_srv, NULL, &temperature_indoor_sensor, &temp);
	if (err) {
		printk("Error publishing temperature(%d)\n", err);
	}
	return err;
}
```
