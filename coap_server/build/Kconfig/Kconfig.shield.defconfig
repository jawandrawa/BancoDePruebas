## coap_server/build/Kconfig/Kconfig.shield.defconfig
```kconfig
osource "c:/users/aleja/documents/teleco/tfg_conectividad/coap_server/boards/shields/*/Kconfig.defconfig"
osource "C:/ncs/v2.5.0-rc1/nrf/boards/shields/*/Kconfig.defconfig"
```
